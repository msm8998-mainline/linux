// SPDX-License-Identifier: BSD-3-Clause
/*
 * Copyright (c) 2025, Giovanni Ricca <giovanniricca@proton.me>
 */

#include "msm8998-nubia-common.dtsi"

/ {
	model = "Nubia Z17";
	compatible = "nubia,nx563j", "qcom,msm8998";
	chassis-type = "handset";
};
